## arch/mips/mach-pic32/Kconfig
```kconfig
menu "Microchip PIC32 platforms"
	depends on MACH_PIC32

config SYS_SOC
	default "pic32mzda" if SOC_PIC32MZDA

choice
	prompt "PIC32 SoC select"

config SOC_PIC32MZDA
	bool "Microchip PIC32MZ[DA] family"
	select SUPPORTS_LITTLE_ENDIAN
	select SUPPORTS_CPU_MIPS32_R1
	select SUPPORTS_CPU_MIPS32_R2
	select MIPS_L1_CACHE_SHIFT_4
	select SYS_MIPS_CACHE_INIT_RAM_LOAD
	help
	  This supports Microchip PIC32MZ[DA] family of microcontrollers.

config SOC_PIC32MZ
	bool "Microchip PIC32MZ[XY] family"
	select SUPPORTS_LITTLE_ENDIAN
	select SUPPORTS_CPU_MIPS32_R1
	select SUPPORTS_CPU_MIPS32_R2
	select MIPS_L1_CACHE_SHIFT_4
	#select SYS_MIPS_CACHE_INIT_RAM_LOAD
	help
	  This supports Microchip PIC32MZ[XY] family of microcontrollers.

endchoice

choice
	prompt "Board select"

config TARGET_PIC32MZDASK
	bool "Microchip PIC32MZ[DA] Starter Kit"
	depends on SOC_PIC32MZDA
	help
	  This supports Microchip PIC32MZ[DA] Starter Kit.

config TARGET_PIC32MZSK
	bool "Microchip PIC32MZ[XY] Starter Kit"
	depends on SOC_PIC32MZ
	help
	  This supports Microchip PIC32MZ[XY] Starter Kit.

endchoice

source "board/microchip/pic32mzda/Kconfig"
source "board/microchip/pic32mz/Kconfig"

endmenu
```

## board/microchip/pic32mz/Kconfig
```kconfig
if TARGET_PIC32MZSK

config SYS_BOARD
	default "pic32mz"

config SYS_VENDOR
	default "microchip"

config SYS_CONFIG_NAME
	default "pic32mzsk"

config SYS_TEXT_BASE
	# ROM version
	#default 0xbd000000
	# RAM version
	default 0x80001000

endif
```

## configs/pic32mzdask_defconfig
```kconfig
CONFIG_MIPS=y
CONFIG_MACH_PIC32=y
CONFIG_SOC_PIC32MZDA=y
CONFIG_TARGET_PIC32MZDASK=y
CONFIG_SYS_LITTLE_ENDIAN=y
CONFIG_HUSH_PARSER=y
CONFIG_SYS_HUSH_PARSER=y
CONFIG_SYS_PROMPT="dask # "
CONFIG_CMD_NET=y
CONFIG_CMD_TIME=y
# CONFIG_CMD_IMLS is not set
CONFIG_SUPPORT_OF_CONTROL=y
CONFIG_OF_EMBED=y
CONFIG_DEFAULT_DEVICE_TREE="pic32mzda_sk"
CONFIG_DM=y
CONFIG_CMD_DM=y
CONFIG_DM_SERIAL=y
CONFIG_PIC32_SERIAL=y
CONFIG_CLK=y
CONFIG_PINCTRL=y
# CONFIG_PINCTRL_FULL is not set
CONFIG_PIC32_PINCTRL=y
CONFIG_DM_MMC=y
CONFIG_PIC32_SDHCI=y
CONFIG_DM_GPIO=y
CONFIG_CMD_GPIO=y
CONFIG_PIC32_GPIO=y
CONFIG_NET=y
CONFIG_DM_ETH=y
CONFIG_PHYLIB=y
CONFIG_NETDEVICES=y
CONFIG_PIC32_ETH=y
```
